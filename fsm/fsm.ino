#include <Wire.h>
#include <SFE_MicroOLED.h> //Click here to get the library: http://librarymanager/All#SparkFun_Micro_OLED
#include "accl.h"
#include "pdm_ex.h"

#define PIN_RESET 9
#define DC_JUMPER 1 // Set to either 0 (SPI, default) or 1 (I2C) based on jumper, matching the value of the DC Jumper
MicroOLED oled(PIN_RESET, DC_JUMPER);

uint8_t state_bitmaps[][384] = {
  //idle
  {0xff, 0xff, 0xff, 0xff, 0xff, 0xff, 0xff, 0xff, 0xff, 0xff, 0xff, 0xff, 0xff, 0xff, 0xff, 0xff, 
0x7f, 0x3f, 0x1f, 0x1f, 0x1f, 0x8f, 0x8f, 0x8f, 0x0f, 0x1f, 0x1f, 0x1f, 0x3f, 0x7f, 0xff, 0xff, 
0xff, 0x7f, 0x3f, 0x3f, 0x1f, 0x1f, 0x0f, 0x8f, 0x8f, 0x8f, 0x1f, 0x1f, 0x1f, 0x3f, 0x7f, 0xff, 
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0xf1, 0xf1, 0xf8, 0xfc, 0xfe, 0xfe, 0xfe, 0xfe, 0xfe, 0xff, 0xff, 0xff, 0xff, 0xff, 0xff, 0xff},
  // look
  {0xff, 0xff, 0xff, 0xff, 0xff, 0xff, 0xff, 0xff, 0xff, 0xff, 0xff, 0x7f, 0x3f, 0x3f, 0x1f, 0x1f, 
0x0f, 0x0f, 0x0f, 0x0f, 0x0f, 0x07, 0x07, 0x07, 0x07, 0x07, 0x07, 0x07, 0x07, 0x07, 0x07, 0x0f, 
0x0f, 0x0f, 0x0f, 0x0f, 0x1f, 0x1f, 0x3f, 0x3f, 0x7f, 0x7f, 0xff, 0xff, 0xff, 0xff, 0xff, 0xff, 
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0xff, 0xff, 0xff, 0xff, 0xff, 0xff, 0xff, 0xff, 0xff, 0xff, 0xff, 0xff, 0xff, 0xff, 0xff, 0xff},
  // listen
  {0xff, 0xff, 0xff, 0xff, 0xff, 0x7f, 0x3f, 0x1f, 0x0f, 0x0f, 0x87, 0xc7, 0xc7, 0xe3, 0xe3, 0xe3, 
0xe3, 0xe3, 0xe3, 0xc7, 0xc7, 0x87, 0x0f, 0x0f, 0x1f, 0x3f, 0x7f, 0xff, 0xff, 0xff, 0xff, 0xff, 
0xff, 0xff, 0xff, 0xff, 0xff, 0xff, 0xff, 0xff, 0xff, 0xff, 0xff, 0xff, 0xff, 0xff, 0xff, 0xff, 
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0xff, 0xff, 0xff, 0xff, 0xff, 0xff, 0xff, 0xff, 0xff, 0xff, 0xff, 0xff, 0xff, 0xff, 0xff, 0xff},
  // touch
  {0xff, 0xff, 0xff, 0xff, 0xff, 0xff, 0xff, 0xff, 0xff, 0xff, 0x3f, 0xbf, 0xdf, 0xef, 0xef, 0xef, 
0xef, 0xef, 0xef, 0xdf, 0xbf, 0x3f, 0xff, 0xff, 0xff, 0xff, 0xff, 0xff, 0xff, 0xff, 0xff, 0xff, 
0xff, 0xff, 0xff, 0xff, 0xff, 0xff, 0xff, 0xff, 0xff, 0xff, 0xff, 0xff, 0xff, 0xff, 0xff, 0xff, 
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0xff, 0xff, 0xff, 0xff, 0xff, 0xff, 0xff, 0xff, 0xff, 0xff, 0xff, 0xff, 0xff, 0xff, 0xff, 0xff}
};

bool displayDetected = false;

void setup() {
  Wire.begin();
  Wire.setClock(400000);
  Serial.begin(115200);

  //0x3D is default address on Qwiic board
  if (isConnected(0x3D) == true || isConnected(0x3C) == true)
  {
    displayDetected = true;
  }
  else
  {
    while (1);
  }

  if (displayDetected)
  {
    oled.begin();     // Initialize the OLED
    oled.clear(PAGE); // Clear the display's internal memory
    oled.clear(ALL);  // Clear the library's display buffer
    oled.setFontType(1);
    oled.setColor(BLACK);
    oled.display();   // Display what's in the buffer (splashscreen)
  }
  accl_init(300);
  init_pdm();
}

enum State {IDLE, LOOK, LISTEN, TOUCH};

State curr_state = IDLE;
int counter = 0;

void loop() {
  
  oled.setCursor(0, 0);
  oled.drawBitmap(state_bitmaps[curr_state]);
  oled.setCursor(50, 30);
  oled.write(48 + counter);
  oled.display();
  int _ = accl_sample();
  bool isShaken = accl_isShaken();
  bool isTriggered = process_samples_timeout();

  switch (curr_state) {
    case IDLE:    
      if (isTriggered) { 
        curr_state = LOOK;
        counter = 0;
      }
      break;
    case LOOK:
      if (isTriggered) {
        counter++;
        if (counter == 5) {
          curr_state = LISTEN;
          counter = 0;
        }
      }
      break;
    case LISTEN:
      if (isTriggered) {
        counter++;
        if (counter == 4) {
          curr_state = TOUCH;
          counter = 0;        
        }
      }      
      break;
    case TOUCH:
      if (isTriggered) {
        counter++;
        if (counter == 3) {
          curr_state = IDLE;
          counter = 0;
        }
      }
      break;
  }
}

bool isConnected(uint8_t deviceAddress)
{
  Wire.beginTransmission(deviceAddress);
  if (Wire.endTransmission() == 0)
    return true;
  return false;
}

int mic_isTriggered_count = 0;
bool mic_isTriggered() {
  mic_isTriggered_count ++;
  return mic_isTriggered_count%100 == 0;
}
