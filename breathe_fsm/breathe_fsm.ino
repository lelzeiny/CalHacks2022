#include <Wire.h>
#include <SFE_MicroOLED.h> //Click here to get the library: http://librarymanager/All#SparkFun_Micro_OLED

#define PIN_RESET 9
#define DC_JUMPER 1 // Set to either 0 (SPI, default) or 1 (I2C) based on jumper, matching the value of the DC Jumper
MicroOLED oled(PIN_RESET, DC_JUMPER);

uint8_t state_bitmaps[][384] = {
  //idle
  {0xff, 0xff, 0xff, 0xff, 0xff, 0xff, 0xff, 0xff, 0xff, 0xff, 0xff, 0xff, 0xff, 0xff, 0xff, 0xff, 
0x7f, 0x3f, 0x1f, 0x1f, 0x1f, 0x8f, 0x8f, 0x8f, 0x0f, 0x1f, 0x1f, 0x1f, 0x3f, 0x7f, 0xff, 0xff, 
0xff, 0x7f, 0x3f, 0x3f, 0x1f, 0x1f, 0x0f, 0x8f, 0x8f, 0x8f, 0x1f, 0x1f, 0x1f, 0x3f, 0x7f, 0xff, 
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0xf1, 0xf1, 0xf8, 0xfc, 0xfe, 0xfe, 0xfe, 0xfe, 0xfe, 0xff, 0xff, 0xff, 0xff, 0xff, 0xff, 0xff},
  //in
  {0xff, 0xff, 0xff, 0xff, 0xff, 0xff, 0xff, 0xff, 0xff, 0xff, 0xff, 0xff, 0x0f, 0x0f, 0x0f, 0x3f, 
0xff, 0xff, 0xff, 0xff, 0xff, 0xff, 0xff, 0xff, 0xff, 0xff, 0xff, 0xff, 0xff, 0xff, 0xff, 0xff, 
0xff, 0xff, 0xff, 0xff, 0xff, 0xff, 0xff, 0xff, 0xff, 0xff, 0xff, 0xff, 0xff, 0xff, 0xff, 0xff, 
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0xff, 0xff, 0xff, 0xff, 0xff, 0xff, 0xff, 0xff, 0xff, 0xff, 0xff, 0xff, 0xff, 0xff, 0xff, 0xff},
  // out
  {0xff, 0xff, 0xff, 0xff, 0xff, 0xff, 0xff, 0xff, 0xff, 0xff, 0xff, 0xff, 0x0f, 0x0f, 0x0f, 0x3f, 
0xff, 0xff, 0xff, 0xff, 0xff, 0xff, 0xff, 0xff, 0xff, 0xff, 0xff, 0xff, 0xff, 0xff, 0xff, 0xff, 
0xff, 0xff, 0xff, 0xff, 0xff, 0xff, 0xff, 0xff, 0xff, 0xff, 0xff, 0xff, 0xff, 0xff, 0xff, 0xff, 
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0xff, 0xff, 0xff, 0xff, 0xff, 0xff, 0xff, 0xff, 0xff, 0xff, 0xff, 0xff, 0xff, 0xff, 0xff, 0xff},
  // hold
  {0xff, 0xff, 0xff, 0xff, 0xff, 0xff, 0xff, 0xff, 0xff, 0xff, 0xff, 0xff, 0x0f, 0x0f, 0x0f, 0x3f, 
0xff, 0xff, 0xff, 0xff, 0xff, 0xff, 0xff, 0xff, 0xff, 0xff, 0xff, 0xff, 0x7f, 0x7f, 0xff, 0xff, 
0xff, 0xff, 0xff, 0xff, 0xff, 0xff, 0xff, 0xff, 0xff, 0xff, 0xff, 0xff, 0xff, 0xff, 0xff, 0xff, 
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0xff, 0xff, 0xff, 0xff, 0xff, 0xff, 0xff, 0xff, 0xff, 0xff, 0xff, 0xff, 0xff, 0xff, 0xff, 0xff};

bool displayDetected = false;

void setup() {
  Wire.begin();
  Wire.setClock(400000);

  //0x3D is default address on Qwiic board
  if (isConnected(0x3D) == true || isConnected(0x3C) == true)
  {
    displayDetected = true;
  }
  else
  {
    while (1);
  }

  if (displayDetected)
  {
    oled.begin();     // Initialize the OLED
    oled.clear(PAGE); // Clear the display's internal memory
    oled.clear(ALL);  // Clear the library's display buffer
    oled.setFontType(1);
    oled.setColor(BLACK);
    oled.display();   // Display what's in the buffer (splashscreen)
  }
}

enum State {IDLE, IN, OUT, HOLD};

State curr_state = IDLE;
int counter = 0;

void loop() {
  
  oled.setCursor(0, 0);
  oled.drawBitmap(state_bitmaps[curr_state]);
  oled.setCursor(50, 30);
  oled.write(48 + counter);
  oled.display();

  switch (curr_state) {
    case IDLE:
      curr_state = IN;
      counter = 0;
      break;
    case IN:
      if (counter == 4) {
        curr_state = OUT;
        counter = 0;
      } else {
        counter++;
      }
      break;
    case OUT:
      if (counter == 4) {
        curr_state = HOLD;
        counter = 0;        
      } else {
        counter++;
      }
      break;
    case HOLD:
      if (counter == 4) {
        curr_state = IDLE;
        counter = 0;
      } else {
        counter++;
      }
      break;
  }
  delay(1000);
}

bool isConnected(uint8_t deviceAddress)
{
  Wire.beginTransmission(deviceAddress);
  if (Wire.endTransmission() == 0)
    return true;
  return false;
}
